/* source key position labels */
#include "zmk-helpers/key-labels/42.h"

/* map Zen's extra keys */
#define X_LH  &kp LGUI      // thumb row, left
#define X_RH  &smart_mouse  // thumb row, right
#define X_LT  &kp TAB       // top row, left
#define X_LM  &kp LSHFT     // middle row, left
#define X_LB  &kp LCTRL     // bottom row, left
#define X_RT  &kp BACKSPACE // top row, right
#define X_RM  &kp APOS      // middle row, right
#define X_RB  &kp RSHFT     // bottom row, right
/* activate bluetooth */
#define CONFIG_WIRELESS 1

/* source the main keymap */
#include "base.keymap"

/* use 5-column layout for Zen */
//ZMK_APPLY_MATRIX_TRANSFORM(five_column_transform)
